## boards/shields/liaison/Kconfig.defconfig
```kconfig
if SHIELD_LIAISON_DONGLE

config ZMK_KEYBOARD_NAME
    default "liaison"

config ZMK_SPLIT_ROLE_CENTRAL
    default y

endif

if SHIELD_LIAISON_LEFT || SHIELD_LIAISON_RIGHT || SHIELD_LIAISON_DONGLE

config ZMK_SPLIT
    default y

endif
```

## boards/shields/liaison/Kconfig.shield
```kconfig
config SHIELD_LIAISON_LEFT
    def_bool $(shields_list_contains,liaison_left)

config SHIELD_LIAISON_RIGHT
    def_bool $(shields_list_contains,liaison_right)

config SHIELD_LIAISON_DONGLE
    def_bool $(shields_list_contains,liaison_dongle)
```
